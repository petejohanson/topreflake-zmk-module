## boards/arm/petejohanson_topreflake/Kconfig.board
```kconfig
# topreflake board configuration

# Copyright (c) 2024 Pete Johanson
# SPDX-License-Identifier: MIT

config BOARD_PETEJOHANSON_TOPREFLAKE
	bool "topreflake board"
	depends on SOC_PART_NUMBER_SAMD21E18A
	select GPIO
	select ADC
	select ZMK_KSCAN_EC_MATRIX_FAKE_OPEN_DRAIN
```

## boards/arm/petejohanson_topreflake/Kconfig.defconfig
```kconfig
# topreflake board configuration 
# Copyright (c) 2024 Pete Johanson
# SPDX-License-Identifier: MIT

config BOARD
	default "topreflake"
	depends on BOARD_PETEJOHANSON_TOPREFLAKE
```

## boards/arm/petejohanson_topreflake/petejohanson_topreflake_defconfig
```kconfig
# SPDX-License-Identifier: MIT

CONFIG_BOARD_PETEJOHANSON_TOPREFLAKE=y

CONFIG_SOC_SERIES_SAMD21=y
CONFIG_SOC_PART_NUMBER_SAMD21E18A=y
CONFIG_SOC_ATMEL_SAMD_OSC8M=y
CONFIG_SOC_ATMEL_SAMD_OSC8M_AS_MAIN=y
CONFIG_CORTEX_M_SYSTICK=y

CONFIG_PINCTRL=y

CONFIG_USE_DT_CODE_PARTITION=y
CONFIG_BOOTLOADER_BOSSA=y
CONFIG_BOOTLOADER_BOSSA_ADAFRUIT_UF2=y
CONFIG_BUILD_OUTPUT_UF2=y

CONFIG_ZMK_KEYBOARD_NAME="TopreFlake"
CONFIG_ZMK_USB=y

CONFIG_FLASH=y
CONFIG_FLASH_PAGE_LAYOUT=y
CONFIG_FLASH_MAP=y
CONFIG_MPU_ALLOW_FLASH_WRITE=y

CONFIG_NVS=y

CONFIG_SETTINGS=y
CONFIG_SETTINGS_NVS=y

CONFIG_ZMK_STUDIO_LOCKING=n
```
